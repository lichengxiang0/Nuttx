## apps/examples/myled/Kconfig
```kconfig
#
# For a description of the syntax of this configuration file,
# see the file kconfig-language.txt in the NuttX tools repository.
#

config EXAMPLES_MYLED
	tristate "\"MylED!\" example"
	default n
	---help---
		Enable the \"MyLED!\" example

if EXAMPLES_MYLED

config EXAMPLES_MYLED_PROGNAME
	string "Program name"
	default "myled"
	depends on BUILD_LOADABLE
	---help---
		This is the name of the program that will be use when the NSH ELF
		program is installed.

config EXAMPLES_MYLED_PRIORITY
	int "MyLED task priority"
	default 100

config EXAMPLES_MYLED_STACKSIZE
	int "MyLED stack size"
	default 2048

endif
```

## apps/examples/myled2/Kconfig
```kconfig
#
# For a description of the syntax of this configuration file,
# see the file kconfig-language.txt in the NuttX tools repository.
#

config EXAMPLES_MYLED2
	tristate "\"MylED2!\" example"
	default n
	---help---
		Enable the \"MyLED2!\" example

if EXAMPLES_MYLED2

config EXAMPLES_MYLED2_PROGNAME
	string "Program name"
	default "myled2"
	depends on BUILD_LOADABLE
	---help---
		This is the name of the program that will be use when the NSH ELF
		program is installed.

config EXAMPLES_MYLED2_PRIORITY
	int "MyLED2 task priority"
	default 100

config EXAMPLES_MYLED2_STACKSIZE
	int "MyLED2 stack size"
	default 2048

endif
```

## apps/examples/pencil/Kconfig
```kconfig
#
# For a description of the syntax of this configuration file,
# see the file kconfig-language.txt in the NuttX tools repository.
#

config EXAMPLES_PENCIL
	tristate "Verify C++ pencil operations"
	default n
	---help---
		Enable the a simple test to verify C++ test operations.

if EXAMPLES_PENCIL

config EXAMPLES_PENCIL_PROGNAME
	string "Program name"
	default "pencil"
	depends on BUILD_LOADABLE
	---help---
		This is the name of the program that will be use when the NSH ELF
		program is installed.

config EXAMPLES_PENCIL_PRIORITY
	int "PENCIL task priority"
	default 100

config EXAMPLES_PENCIL_STACKSIZE
	int "PENCIL stack size"
	default 2048


endif 
```
